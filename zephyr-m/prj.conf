## CMakeLists.txt
```
# SPDX-License-Identifier: Apache-2.0

cmake_minimum_required(VERSION 3.20.0)

# Select the AI layer's Kconfig fragments before Zephyr processes configuration.
list(APPEND EXTRA_CONF_FILE
  "${CMAKE_CURRENT_SOURCE_DIR}/ai_layer/components.conf"
  "${CMAKE_CURRENT_SOURCE_DIR}/ai_layer/operators.conf"
)

find_package(Zephyr REQUIRED HINTS $ENV{ZEPHYR_BASE})
project(zephyr_m)

add_subdirectory(ai_layer)

# Match the CMSIS project warning policy for third-party ExecuTorch sources
# without suppressing diagnostics in the application or the rest of Zephyr.
target_compile_options(cmsis_executorch PRIVATE
  $<$<COMPILE_LANGUAGE:CXX>:-Wno-deprecated-declarations>
  $<$<COMPILE_LANG_AND_ID:CXX,ARMClang>:-Wno-nan-infinity-disabled>
  $<$<COMPILE_LANG_AND_ID:CXX,GNU>:-Wno-psabi>
)

# GCC 15 diagnoses the int32_t*/long* difference in the MVE intrinsic
# declarations used by Zephyr's current CMSIS-NN module as a C constraint
# error. Both types are 32-bit for this target; retain the diagnostic as a
# warning until the module declarations are updated.
if(CMAKE_C_COMPILER_ID STREQUAL "GNU")
  target_compile_options(modules__cmsis-nn PRIVATE
    $<$<COMPILE_LANGUAGE:C>:-Wno-incompatible-pointer-types>)
endif()

# Zephyr already provides sys/types.h for AC6; the bare-metal pack shim
# must not shadow it. Only libc++ needs compatibility adjustments here.
if(CMAKE_CXX_COMPILER_ID STREQUAL "ARMClang")
  # AC6 6.24's register coalescer crashes on this pack's quantization code
  # with hard-float at -Og/-O1; -O2 avoids it and keeps the kernel optimized.
  if(CONFIG_FP_HARDABI)
    get_target_property(_et_sources cmsis_executorch SOURCES)
    set(_et_quantize_workaround_applied FALSE)
    foreach(_source IN LISTS _et_sources)
      if(_source MATCHES "[/\\\\]op_quantize\\.cpp$")
        set_property(SOURCE "${_source}" TARGET_DIRECTORY cmsis_executorch
          APPEND PROPERTY COMPILE_OPTIONS -O2)
        set(_et_quantize_workaround_applied TRUE)
      endif()
    endforeach()
    if(NOT _et_quantize_workaround_applied)
      message(FATAL_ERROR
        "AC6 workaround could not find ExecuTorch op_quantize.cpp")
    endif()
  endif()

  # Zephyr's armstdc wrappers use #include_next to chain into AC6's C headers,
  # and AC6 6.24's libc++ wrappers must precede both (notably stddef.h).
  # Explicitly add both system include paths in order: libcxx -> armstdc -> include.
  get_filename_component(_ac6_bin "${CMAKE_CXX_COMPILER}" DIRECTORY)
  get_filename_component(_ac6_include "${_ac6_bin}/../include" ABSOLUTE)
  get_filename_component(_ac6_libcxx "${_ac6_include}/libcxx" ABSOLUTE)
  if(IS_DIRECTORY "${_ac6_libcxx}")
    target_include_directories(zephyr_interface SYSTEM BEFORE INTERFACE
      "$<$<COMPILE_LANGUAGE:CXX>:${_ac6_libcxx}>")
  endif()
  if(IS_DIRECTORY "${_ac6_include}")
    target_include_directories(zephyr_interface SYSTEM INTERFACE
      "${_ac6_include}")
  endif()
  zephyr_compile_options(
    "$<$<COMPILE_LANGUAGE:CXX>:-include${CMAKE_CURRENT_SOURCE_DIR}/src/zephyr_ac6_compat.hpp>")

  # Zephyr's CMake scatter generator disables CONFIG_STATIC_INIT_GNU,
  # omitting the constructor runner and the companion destructor handler.
  if(NOT CONFIG_STATIC_INIT_GNU)
    zephyr_linker_section_configure(SECTION ctors
      INPUT ".init_array*" SORT NAME KEEP
      SYMBOLS __ac6_init_array_start __ac6_init_array_end)
    zephyr_link_libraries("--keep=*.o(.init_array*)")
    target_sources(app PRIVATE src/zephyr_ac6_init.c
      "${ZEPHYR_BASE}/lib/cpp/abi/cpp_dtors.c")
  endif()

  # Zephyr hard-codes microlib for armlink. ExecuTorch's full libc++ needs
  # the standard Arm C runtime required by libc++.
  foreach(_elf zephyr_pre0 zephyr_pre1 zephyr_final)
    if(TARGET ${_elf})
      get_target_property(_libs ${_elf} LINK_LIBRARIES)
      list(REMOVE_ITEM _libs "--library_type=microlib")
      set_property(TARGET ${_elf} PROPERTY LINK_LIBRARIES "${_libs}")
    endif()
  endforeach()
endif()

target_sources(app PRIVATE
  src/main.c
  src/arm_embedded_module.cpp
)
if(CONFIG_EXECUTORCH_MULTIPLE_TEST)
  target_sources(app PRIVATE src/executorch_multiple_test.cpp)
else()
  target_sources(app PRIVATE src/executorch_test.cpp)
endif()

target_include_directories(app PRIVATE src)
target_compile_definitions(app PRIVATE EXECUTORCH_TARGET_NAME="Cortex-M55")

# Keep runtime logging consistent with the generated AI layer configuration.
zephyr_compile_definitions(ET_LOG_ENABLED=0)
```

## prj.conf
```kconfig
# Set y after selecting TinyCNNMultiple.pt2 in the csolution and regenerating ai_layer.
CONFIG_EXECUTORCH_MULTIPLE_TEST=n

# Use the CMSIS-NN module from the Zephyr workspace. The generated ExecuTorch
# operator configuration selects the individual CMSIS-NN source groups needed
# by the model.
CONFIG_CMSIS_NN=y

# C++ allocations must use a heap initialized by Zephyr.
CONFIG_HEAP_MEM_POOL_SIZE=16384
CONFIG_COMMON_LIBC_MALLOC=y
CONFIG_COMMON_LIBC_MALLOC_ARENA_SIZE=65536

CONFIG_CPP=y
CONFIG_STD_CPP17=y

# Use the Cortex-M55 hardware FPU and pass floating-point arguments in FP
# registers.
CONFIG_FPU=y
CONFIG_FP_HARDABI=y

# Runtime loading uses C++ containers; the runner also prints float logits.
CONFIG_MAIN_STACK_SIZE=16384
CONFIG_REQUIRES_FLOAT_PRINTF=y
```

## app.conf
```kconfig
# The AppKit image starts after the platform firmware in MRAM.
CONFIG_FLASH_LOAD_OFFSET=0x200000
```

## src/main.c
```c
/*
 * Copyright (c) 2012-2014 Wind River Systems, Inc.
 * Copyright 2026 Arm Limited and/or its affiliates.
 *
 * SPDX-License-Identifier: Apache-2.0
 */

#include <stdio.h>

#include "executorch_test.h"

int main(void)
{
	printf("Hello World! %s\n", CONFIG_BOARD_TARGET);
	return executorch_run_test();
}
```

## src/arm_embedded_module.cpp
```c
/*
 * Copyright (c) Meta Platforms, Inc. and affiliates.
 * All rights reserved.
 *
 * This source code is licensed under the BSD-style license found in
 * src/LICENSE-ExecuTorch (the ExecuTorch license).
 *
 * Customization for embedded systems by Arm.
 */
#include "arm_embedded_module.hpp"

#include <executorch/extension/data_loader/buffer_data_loader.h>

using executorch::extension::BufferDataLoader;

namespace arm
{
  namespace embedded
  {

    EmbeddedModule::EmbeddedModule(const unsigned char *pte_data,
                                   size_t pte_size,
                                   std::unique_ptr<DataLoader> data_loader,
                                   std::unique_ptr<MemoryAllocator> memory_allocator,
                                   std::unique_ptr<MemoryAllocator> temp_allocator)
        : data_loader_(std::move(data_loader)),
          memory_allocator_(std::move(memory_allocator)),
          temp_allocator_(std::move(temp_allocator)),
          pte_data_(pte_data), pte_size_(pte_size)
    {
    }

    ET_NODISCARD Error EmbeddedModule::load(
        const Program::Verification verification)
    {
      if (!is_loaded())
      {
        if (!data_loader_)
        {
          return Error::MemoryAllocationFailed;
        }
        Result<Program> res_program = Program::load(data_loader_.get(), verification);
        if (!res_program.ok())
        {
          return res_program.error();
        }
        auto program =
            std::make_unique<std::remove_reference_t<decltype(*res_program)>>(
                std::move(*res_program));
        program_ = std::shared_ptr<Program>(
            program.release(), [](Program *pointer)
            { delete pointer; });
      }
      return Error::Ok;
    }

    Result<size_t> EmbeddedModule::num_methods()
    {
      ET_CHECK_OK_OR_RETURN_ERROR(load());
      return program_->num_methods();
    }

    Result<std::unordered_set<std::string>> EmbeddedModule::method_names()
    {
      ET_CHECK_OK_OR_RETURN_ERROR(load());
      const auto method_count = program_->num_methods();
      std::unordered_set<std::string> result;
      result.reserve(method_count);

      for (size_t index = 0; index < method_count; ++index)
      {
        result.emplace(program_->get_method_name(index).get());
      }
      return result;
    }

    Error EmbeddedModule::load_method(
        const std::string &method_name,
        HierarchicalAllocator *planned_memory,
        EventTracer *event_tracer)
    {
      if (!is_method_loaded(method_name))
      {
        ET_CHECK_OK_OR_RETURN_ERROR(load());

        MethodHolder method_holder;

        if (!planned_memory)
        {
          auto method_metadata_result = program_->method_meta(method_name.c_str());
          if (!method_metadata_result.ok())
          {
            return method_metadata_result.error();
          }
          const auto method_metadata = std::move(*method_metadata_result);
          const auto planned_buffers_count =
              method_metadata.num_memory_planned_buffers();
          method_holder.planned_buffers.reserve(planned_buffers_count);
          method_holder.planned_spans.reserve(planned_buffers_count);

          for (size_t index = 0; index < planned_buffers_count; ++index)
          {
            const auto buffer_size =
                static_cast<size_t>(method_metadata.memory_planned_buffer_size(index).get());

            uint8_t *buffer = reinterpret_cast<uint8_t *>(
                memory_allocator_->allocate(buffer_size, 16UL));
            if (buffer == nullptr)
            {
              ET_LOG(Error, "Could not allocate memory for memory planned buffer size %d", (int)buffer_size);
              return Error::MemoryAllocationFailed;
            }

            method_holder.planned_buffers.push_back(buffer);
            method_holder.planned_spans.push_back({method_holder.planned_buffers.back(), buffer_size});
          }
          method_holder.planned_memory =
              std::make_unique<HierarchicalAllocator>(Span(
                  method_holder.planned_spans.data(),
                  method_holder.planned_spans.size()));
          planned_memory = method_holder.planned_memory.get();
        }
        method_holder.memory_manager = std::make_unique<MemoryManager>(
            memory_allocator_.get(), planned_memory, temp_allocator_.get());
        auto res_method = program_->load_method(
            method_name.c_str(),
            method_holder.memory_manager.get(),
            event_tracer ? event_tracer : this->event_tracer());
        if (!res_method.ok())
        {
          return res_method.error();
        }
        method_holder.method =
            std::make_unique<std::remove_reference_t<decltype(*res_method)>>(
                std::move(*res_method));
        methods_.emplace(method_name, std::move(method_holder));
      }
      return Error::Ok;
    }

    #if 0
    ET_NODISCARD Result<Method *> EmbeddedModule::method(
        const std::string &method_name)
    {
      ET_CHECK_OK_OR_RETURN_ERROR(load_method(method_name));
      return methods_[method_name].method.get();
    }
    #endif

    Result<MethodMeta> EmbeddedModule::method_meta(const std::string &method_name)
    {
      ET_CHECK_OK_OR_RETURN_ERROR(load());
      return program_->method_meta(method_name.c_str());
    }

    Result<std::vector<EValue>> EmbeddedModule::execute(
        const std::string &method_name,
        const std::vector<EValue> &input_values)
    {
      ET_CHECK_OK_OR_RETURN_ERROR(load_method(method_name));
      auto &method = methods_.at(method_name).method;
      for (size_t index = 0; index < input_values.size(); ++index)
      {
        ET_CHECK_OK_OR_RETURN_ERROR(method->set_input(input_values[index], index));
      }
      ET_CHECK_OK_OR_RETURN_ERROR(method->execute());
      const auto outputs_size = method->outputs_size();
      std::vector<EValue> outputs(outputs_size);
      ET_CHECK_OK_OR_RETURN_ERROR(
          method->get_outputs(outputs.data(), outputs_size));

      return outputs;
    }

    Error EmbeddedModule::set_input(
        const std::string &method_name,
        const EValue &input_value,
        size_t input_index)
    {
      ET_CHECK_OK_OR_RETURN_ERROR(load_method(method_name));
      auto &method = methods_.at(method_name).method;
      return method->set_input(input_value, input_index);
    }

    Error EmbeddedModule::set_inputs(
        const std::string &method_name,
        const std::vector<EValue> &input_values)
    {
      ET_CHECK_OK_OR_RETURN_ERROR(load_method(method_name));
      auto &method = methods_.at(method_name).method;
      return method->set_inputs(executorch::aten::ArrayRef<EValue>(
          input_values.data(), input_values.size()));
    }

    Error EmbeddedModule::set_output(
        const std::string &method_name,
        EValue output_value,
        size_t output_index)
    {
      ET_CHECK_OK_OR_RETURN_ERROR(load_method(method_name));
      auto &method = methods_.at(method_name).method;
      ET_CHECK_OR_RETURN_ERROR(
          output_value.isTensor(),
          InvalidArgument,
          "output type: %zu is not tensor",
          (size_t)output_value.tag);
      const auto &output_tensor = output_value.toTensor();
      return method->set_output_data_ptr(
          output_tensor.mutable_data_ptr(), output_tensor.nbytes(), output_index);
    }

    Error EmbeddedModule::set_outputs(
        const std::string &method_name,
        const std::vector<EValue> &output_values)
    {
      ET_CHECK_OK_OR_RETURN_ERROR(load_method(method_name));
      auto &method = methods_.at(method_name).method;
      const auto outputs_size = method->outputs_size();
      ET_CHECK_OR_RETURN_ERROR(
          output_values.size() == outputs_size,
          InvalidArgument,
          "output size: %zu is not equal to method output size: %zu",
          output_values.size(),
          outputs_size);
      for (size_t index = 0; index < outputs_size; ++index)
      {
        ET_CHECK_OK_OR_RETURN_ERROR(
            set_output(method_name, output_values[index], index));
      }
      return Error::Ok;
    }

    Result<std::vector<EValue>> EmbeddedModule::get_outputs(
        const std::string &method_name)
    {
      ET_CHECK_OK_OR_RETURN_ERROR(load_method(method_name));
      auto &method = methods_.at(method_name).method;
      const auto outputs_size = method->outputs_size();
      std::vector<EValue> outputs(outputs_size);
      ET_CHECK_OK_OR_RETURN_ERROR(
          method->get_outputs(outputs.data(), outputs_size));
      return outputs;
    }

    Result<EValue> EmbeddedModule::get_output(
        const std::string &method_name,
        size_t output_index)
    {
      ET_CHECK_OK_OR_RETURN_ERROR(load_method(method_name));
      auto &method = methods_.at(method_name).method;
      ET_CHECK_OR_RETURN_ERROR(
          output_index < method->outputs_size(),
          InvalidArgument,
          "output index: %zu is out of range",
          output_index);
      return method->get_output(output_index);
    }

  } // namespace embedded
} // namespace arm
```

## src/arm_embedded_module.hpp
```c
/*
 * Copyright (c) Meta Platforms, Inc. and affiliates.
 * All rights reserved.
 *
 * This source code is licensed under the BSD-style license found in
 * src/LICENSE-ExecuTorch (the ExecuTorch license).
 *
 * Customization for embedded systems by Arm.
 */
#pragma once

#include <executorch/runtime/executor/program.h>
#include <executorch/runtime/core/data_loader.h>

#include <memory>
#include <string>
#include <unordered_map>
#include <unordered_set>
#include <vector>

using namespace ::executorch::runtime;

namespace arm
{
  namespace embedded
  {

    /**
     * A facade class for loading programs and executing methods within them.
     */
    class EmbeddedModule
    {
    public:
      /**
       * Constructs an instance with the provided PTE data and memory allocators.
       *
       * @param[in] pte_data Pointer to the ExecuTorch program data to load.
       * @param[in] pte_size Size of the ExecuTorch program data to load.
       * @param[in] memory_allocator A MemoryAllocator used for memory planning.
       * @param[in] temp_allocator A MemoryAllocator to use when allocating
       * temporary data during kernel or delegate execution.
       */
      explicit EmbeddedModule(
          const unsigned char *pte_data,
          size_t pte_size,
          std::unique_ptr<DataLoader> data_loader = nullptr,
          std::unique_ptr<MemoryAllocator> memory_allocator = nullptr,
          std::unique_ptr<MemoryAllocator> temp_allocator = nullptr);

      /**
       * Loads the program if needed.
       *
       * @param[in] verification The type of verification to do before returning
       * success.
       *
       * @returns An Error to indicate success or failure of the loading process.
       */
      ET_NODISCARD Error load(
          const Program::Verification verification =
              Program::Verification::Minimal);

      /**
       * Checks if the program is loaded.
       *
       * @returns true if the program is loaded, false otherwise.
       */
      inline bool is_loaded() const
      {
        return program_ != nullptr;
      }

      /**
       * Get the program. The data loader used by the program is guaranteed to be
       * valid for the lifetime of the program.
       *
       * @returns Shared pointer to the program or nullptr if it's not yet loaded.
       */
      inline std::shared_ptr<Program> program() const
      {
        return program_;
      }

      /**
       * Get the number of methods available in the loaded program.
       *
       * @returns A Result object containing either the number of methods available
       *          or an error to indicate failure.
       */
      Result<size_t> num_methods();

      /**
       * Get a list of method names available in the loaded program.
       * Loads the program and method if needed.
       *
       * @returns A set of strings containing the names of the methods, or an error
       * if the program or method failed to load.
       */
      Result<std::unordered_set<std::string>> method_names();

      /**
       * Load a specific method from the program and set up memory management if
       * needed. The loaded method is cached to reuse the next time it's executed.
       *
       * @param[in] method_name The name of the method to load.
       * @param[in] planned_memory The memory-planned buffers to use for mutable
       * tensor data when executing a method.
       * @param[in] event_tracer Per-method event tracer to profile/trace methods
       * individually. When not given, the event tracer passed to the
       * EmbeddedModule constructor is used. Otherwise, this per-method event tracer
       * takes precedence.
       *
       * @returns An Error to indicate success or failure.
       */
      ET_NODISCARD
      Error load_method(
          const std::string &method_name,
          HierarchicalAllocator *planned_memory = nullptr,
          EventTracer *event_tracer = nullptr);

      #if 0
      ET_DEPRECATED ET_NODISCARD Error inline load_method(
          const std::string &method_name,
          EventTracer *event_tracer)
      {
        return load_method(method_name, nullptr, event_tracer);
      }
      #endif

      /**
       * Unload a specific method from the program.
       *
       * @param[in] method_name The name of the method to unload.
       *
       * @returns True if the method is unloaded, false if no-op.
       */
      inline bool unload_method(const std::string &method_name)
      {
        return methods_.erase(method_name);
      }

      #if 0
      /**
       * DEPRECATED: EmbeddedModule manages each Method exclusively.
       *
       * Get a method by it's name. Not recommended to use this method directly as
       * an end user. It's exposed to allow for composability of module in apis that
       * operate on method.
       *
       * @param[in] method_name The name of the method to get.
       *
       * @returns A Result object containing either a pointer to the requested
       *          method or an error to indicate failure.
       */
      ET_DEPRECATED ET_NODISCARD Result<Method *> method(
          const std::string &method_name);
      #endif

      /**
       * Checks if a specific method is loaded.
       *
       * @param[in] method_name The name of the method to check.
       *
       * @returns true if the method specified by method_name is loaded, false
       * otherwise.
       */
      inline bool is_method_loaded(const std::string &method_name) const
      {
        return methods_.count(method_name);
      }

      /**
       * Get a method metadata struct by method name.
       * Loads the program if needed.
       *
       * @param[in] method_name The name of the method to get the metadata for.
       *
       * @returns A method metadata, or an error if the program or method failed to
       * load.
       */
      Result<MethodMeta> method_meta(const std::string &method_name);

      /**
       * Execute a specific method with the given input values and retrieve the
       * output values. Loads the program and method before executing if needed.
       *
       * @param[in] method_name The name of the method to execute.
       * @param[in] input_values A vector of input values to be passed to the
       * method.
       *
       * @returns A Result object containing either a vector of output values
       *          from the method or an error to indicate failure.
       */
      ET_NODISCARD Result<std::vector<EValue>> execute(
          const std::string &method_name,
          const std::vector<EValue> &input_values);

      /**
       * Execute a specific method with a single input value.
       * Loads the program and method before executing if needed.
       *
       * @param[in] method_name The name of the method to execute.
       * @param[in] input_value A value to be passed to the method.
       *
       * @returns A Result object containing either a vector of output values
       *          from the method or an error to indicate failure.
       */
      ET_NODISCARD inline Result<std::vector<EValue>> execute(
          const std::string &method_name,
          const EValue &input_value)
      {
        return execute(method_name, std::vector<EValue>(1, input_value));
      }

      /**
       * Execute a specific method without any input values.
       * Loads the program and method before executing if needed.
       *
       * @param[in] method_name The name of the method to execute.
       *
       * @returns A Result object containing either a vector of output values
       *          from the method or an error to indicate failure.
       */
      ET_NODISCARD inline Result<std::vector<EValue>> execute(
          const std::string &method_name)
      {
        return execute(method_name, std::vector<EValue>{});
      }

      /**
       * Retrieve the output value of a specific method with the given input values.
       * Loads the program and method before execution if needed.
       *
       * @param[in] method_name The name of the method to execute.
       * @param[in] input_values A vector of input values to be passed to the
       * method.
       *
       * @returns A Result object containing either the first output value from the
       * method or an error to indicate failure.
       */
      ET_NODISCARD inline Result<EValue> get(
          const std::string &method_name,
          const std::vector<EValue> &input_values)
      {
        auto execute_result = execute(method_name, input_values);
        if (!execute_result.ok())
        {
          return execute_result.error();
        }
        auto result = std::move(*execute_result);
        if (result.empty())
        {
          return Error::InvalidArgument;
        }
        return result[0];
      }

      /**
       * Retrieve the output value of a specific method with a single input value.
       * Loads the program and method before execution if needed.
       *
       * @param[in] method_name The name of the method to execute.
       * @param[in] input_value A value to be passed to the method.
       *
       * @returns A Result object containing either the first output value from the
       * method or an error to indicate failure.
       */
      ET_NODISCARD inline Result<EValue> get(
          const std::string &method_name,
          const EValue &input_value)
      {
        return get(method_name, std::vector<EValue>(1, input_value));
      }

      /**
       * Retrieve the output value of a specific method without any input values.
       * Loads the program and method before execution if needed.
       *
       * @param[in] method_name The name of the method to execute.
       *
       * @returns A Result object containing either the first output value from the
       * method or an error to indicate failure.
       */
      ET_NODISCARD inline Result<EValue> get(
          const std::string &method_name)
      {
        return get(method_name, std::vector<EValue>{});
      }

      /**
       * Execute the 'forward' method with the given input values and retrieve the
       * output values. Loads the program and method before executing if needed.
       *
       * @param[in] input_values A vector of input values for the 'forward' method.
       *
       * @returns A Result object containing either a vector of output values
       *          from the 'forward' method or an error to indicate failure.
       */
      ET_NODISCARD inline Result<std::vector<EValue>> forward(
          const std::vector<EValue> &input_values)
      {
        return execute("forward", input_values);
      };

      /**
       * Execute the 'forward' method with a single value.
       * Loads the program and method before executing if needed.
       *
       * @param[in] input_value A value for the 'forward' method.
       *
       * @returns A Result object containing either a vector of output values
       *          from the 'forward' method or an error to indicate failure.
       */
      ET_NODISCARD inline Result<std::vector<EValue>> forward(
          const EValue &input_value)
      {
        return forward(std::vector<EValue>(1, input_value));
      }

      /**
       * Execute the 'forward' method without any input values.
       * Loads the program and method before executing if needed.
       *
       * @returns A Result object containing either a vector of output values
       *          from the method or an error to indicate failure.
       */
      ET_NODISCARD inline Result<std::vector<EValue>> forward()
      {
        return forward(std::vector<EValue>{});
      }

      /**
       * Sets a single input value for a specific method.
       *
       * @param[in] method_name The name of the method.
       * @param[in] input_value The EValue to set as the method input.
       * @param[in] input_index Zero-based index of the input to set.
       *
       * @returns An Error to indicate success or failure.
       */
      ET_NODISCARD
      Error set_input(
          const std::string &method_name,
          const EValue &input_value,
          size_t input_index);

      /**
       * Sets a single input value for the "forward" method.
       *
       * @param[in] input_value The EValue to set as the method input.
       * @param[in] input_index Zero-based index of the input to set.
       *
       * @returns An Error to indicate success or failure.
       */
      ET_NODISCARD
      inline Error set_input(
          const EValue &input_value,
          size_t input_index)
      {
        return set_input("forward", input_value, input_index);
      }

      /**
       * Sets all input values for a specific method.
       *
       * @param[in] method_name The name of the method.
       * @param[in] input_values A vector of EValues to set as the method inputs.
       *
       * @returns An Error to indicate success or failure.
       */
      ET_NODISCARD
      Error set_inputs(
          const std::string &method_name,
          const std::vector<EValue> &input_values);

      /**
       * Sets all input values for the "forward" method.
       *
       * @param[in] input_values A vector of EValues to set as the method inputs.
       *
       * @returns An Error to indicate success or failure.
       */
      ET_NODISCARD
      inline Error set_inputs(
          const std::vector<EValue> &input_values)
      {
        return set_inputs("forward", input_values);
      }

      /**
       * Sets the output tensor for a specific method.
       *
       * @param[in] method_name The name of the method.
       * @param[in] output_value The EValue containing the Tensor to set as the
       * method output.
       * @param[in] output_index Zero-based index of the output to set.
       *
       * @returns An Error to indicate success or failure.
       *
       * @note Only Tensor outputs are currently supported for setting.
       */
      ET_NODISCARD
      Error set_output(
          const std::string &method_name,
          EValue output_value,
          size_t output_index = 0);

      /**
       * Sets the output tensor for the "forward" method.
       *
       * @param[in] output_value The EValue containing the Tensor to set as the
       * method output.
       * @param[in] output_index Zero-based index of the output to set.
       *
       * @returns An Error to indicate success or failure.
       *
       * @note Only Tensor outputs are currently supported for setting.
       */
      ET_NODISCARD
      inline Error set_output(
          EValue output_value,
          size_t output_index = 0)
      {
        return set_output("forward", std::move(output_value), output_index);
      }

      /**
       * Sets all output tensors for a specific method.
       *
       * Loads the program and method if needed, and for each output uses
       * the provided tensor's data buffer as the method's output buffer.
       *
       * @param[in] method_name The name of the method.
       * @param[in] output_values A vector of EValues to set as the method outputs.
       *
       * @returns An Error to indicate success or failure.
       *
       * @note Only Tensor outputs are currently supported for setting.
       * @note Will fail for outputs that are memory-planned or constants.
       */
      ET_NODISCARD
      Error set_outputs(
          const std::string &method_name,
          const std::vector<EValue> &output_values);

      /**
       * Sets all output tensors for the "forward" method.
       *
       * @param[in] output_values A vector of EValues to set as the method outputs.
       *
       * @returns An Error to indicate success or failure.
       *
       * @note Only Tensor outputs are currently supported for setting.
       * @note Will fail for outputs that are memory-planned or constants.
       */
      ET_NODISCARD
      inline Error set_outputs(
          const std::vector<EValue> &output_values)
      {
        return set_outputs("forward", output_values);
      }

      /**
       * Retrieve all current output values of a specific method without executing
       * it. Loads the program and method before retrieval if needed.
       *
       * @param[in] method_name The name of the method.
       *
       * @returns A Result containing the vector of output values, or an error.
       */
      ET_NODISCARD
      Result<std::vector<EValue>> get_outputs(
          const std::string &method_name);

      /**
       * Retrieve all current output values of the "forward" method without
       * executing it. Loads the program and method before retrieval if needed.
       *
       * @returns A Result containing the vector of output values, or an error.
       */
      ET_NODISCARD
      inline Result<std::vector<EValue>> get_outputs()
      {
        return get_outputs("forward");
      }

      /**
       * Retrieve a single current output value of a specific method without
       * executing it. Loads the program and method before retrieval if needed.
       *
       * @param[in] method_name The name of the method.
       * @param[in] output_index Zero-based index of the output to retrieve.
       *
       * @returns A Result containing the requested output value, or an error.
       */
      ET_NODISCARD
      Result<EValue> get_output(
          const std::string &method_name,
          size_t output_index = 0);

      /**
       * Retrieve a single current output value of the "forward" method without
       * executing it. Loads the program and method before retrieval if needed.
       *
       * @param[in] output_index Zero-based index of the output to retrieve.
       *
       * @returns A Result containing the requested output value, or an error.
       */
      ET_NODISCARD
      inline Result<EValue> get_output(size_t output_index = 0)
      {
        return get_output("forward", output_index);
      }

      /**
       * Retrieves the EventTracer instance being used by the EmbeddedModule.
       * EventTracer is used for tracking and logging events during the execution
       * of methods.
       *
       * @returns A pointer to the EventTracer instance. Returns nullptr if no
       * EventTracer is set.
       */
      inline EventTracer *event_tracer() const
      {
        return event_tracer_.get();
      }

    private:
      struct MethodHolder
      {
        std::vector<uint8_t *> planned_buffers;
        std::vector<Span<uint8_t>> planned_spans;
        std::unique_ptr<HierarchicalAllocator> planned_memory;
        std::unique_ptr<MemoryManager> memory_manager;
        std::unique_ptr<Method> method;
      };

      std::shared_ptr<Program> program_;
      std::unique_ptr<DataLoader> data_loader_;
      std::unique_ptr<MemoryAllocator> memory_allocator_;
      std::unique_ptr<MemoryAllocator> temp_allocator_;
      // std::unique_ptr<NamedDataMap> merged_data_map_;

      std::unique_ptr<EventTracer> event_tracer_;

      [[maybe_unused]] const unsigned char *pte_data_;
      [[maybe_unused]] size_t pte_size_;

    protected:
      std::unordered_map<std::string, MethodHolder> methods_;
    };

  } // namespace embedded
} // namespace arm
```

## src/executorch_test.cpp
```c
// Copyright 2026 Arm Limited and/or its affiliates.
// SPDX-License-Identifier: Apache-2.0
// Adapted from CMSIS-Executorch/src/app_main.cpp for the Zephyr application.

#include <array>
#include <cstdint>
#include <cstdio>
#include <cstring>
#include <memory>

#include <executorch/extension/data_loader/buffer_data_loader.h>
#include <executorch/runtime/core/evalue.h>
#include <executorch/runtime/core/exec_aten/exec_aten.h>
#include <executorch/runtime/core/memory_allocator.h>
#include <executorch/runtime/platform/runtime.h>

#include "arm_embedded_module.hpp"
#include "executorch_test.h"
#include "TinyCNN_pte.h"

using arm::embedded::EmbeddedModule;
using executorch::aten::DimOrderType;
using executorch::aten::ScalarType;
using executorch::aten::SizesType;
using executorch::aten::Tensor;
using executorch::aten::TensorImpl;
using executorch::extension::BufferDataLoader;
using executorch::runtime::EValue;
using executorch::runtime::MemoryAllocator;

namespace {

#ifndef EXECUTORCH_TARGET_NAME
#define EXECUTORCH_TARGET_NAME "Ethos-U55-256"
#endif

// TinyCNN needs much less space than the original example's two 4 MiB pools.
constexpr size_t kMethodPoolSize = 128 * 1024;
constexpr size_t kTempPoolSize = 64 * 1024;

alignas(64) uint8_t g_method_pool[kMethodPoolSize];
// The default .bss is writable system SRAM on the supplied targets.
alignas(64) uint8_t g_temp_pool[kTempPoolSize];

} // namespace

extern "C" int executorch_run_test(void)
{
  executorch::runtime::runtime_init();
  printf("ExecuTorch %s application: %lu byte program\n", EXECUTORCH_TARGET_NAME,
         TinyCNN_pte_size);

  // Devicetree memory-region sections are NOLOAD and are not zeroed at boot.
  std::memset(g_temp_pool, 0, sizeof(g_temp_pool));

  EmbeddedModule module(
      TinyCNN_pte, TinyCNN_pte_size,
      std::make_unique<BufferDataLoader>(TinyCNN_pte, TinyCNN_pte_size),
      std::make_unique<MemoryAllocator>(kMethodPoolSize, g_method_pool),
      std::make_unique<MemoryAllocator>(kTempPoolSize, g_temp_pool));

  // Same deterministic image values as the CMSIS pack example. The supplied
  // The PTE exposes NCHW, whereas the original runner hard-codes NHWC.
  alignas(16) static float input_data[16 * 16 * 3];
  auto method_meta = module.method_meta("forward");
  if (!method_meta.ok()) {
    printf("Could not read forward metadata (err=%u)\nTest_result: FAIL\n",
           static_cast<unsigned>(method_meta.error()));
    return 1;
  }
  if (method_meta->num_inputs() != 1) {
    printf("forward expected one input\nTest_result: FAIL\n");
    return 1;
  }
  auto input_meta = method_meta->input_tensor_meta(0);
  if (!input_meta.ok() || input_meta->scalar_type() != ScalarType::Float ||
      input_meta->sizes().size() != 4 || input_meta->dim_order().size() != 4 ||
      input_meta->nbytes() != sizeof(input_data)) {
    printf("forward expected a rank-four RGB image with 768 floats\n"
           "Test_result: FAIL\n");
    return 1;
  }

  for (size_t i = 0; i < sizeof(input_data) / sizeof(input_data[0]); ++i) {
    input_data[i] = static_cast<float>(i % 32) / 32.0f - 0.5f;
  }
  std::array<SizesType, 4> sizes;
  std::array<DimOrderType, 4> dim_order;
  for (size_t i = 0; i < sizes.size(); ++i) {
    sizes[i] = input_meta->sizes()[i];
    dim_order[i] = input_meta->dim_order()[i];
  }
  printf("Input shape: [%ld, %ld, %ld, %ld]\n", static_cast<long>(sizes[0]),
         static_cast<long>(sizes[1]), static_cast<long>(sizes[2]),
         static_cast<long>(sizes[3]));
  TensorImpl input_impl(ScalarType::Float, sizes.size(), sizes.data(), input_data,
                        dim_order.data());
  Tensor input(&input_impl);

  auto outputs = module.forward(input);
  if (!outputs.ok()) {
    printf("forward failed (err=%u)\nTest_result: FAIL\n",
           static_cast<unsigned>(outputs.error()));
    return 1;
  }
  if (outputs->size() != 1 || !outputs->front().isTensor()) {
    printf("forward expected one output tensor\nTest_result: FAIL\n");
    return 1;
  }

  const EValue& out = outputs->front();
  Tensor tensor = out.toTensor();
  const auto num_output_elements = tensor.numel();
  if (tensor.scalar_type() != ScalarType::Float || num_output_elements != 10) {
    printf("forward expected ten float logits\nTest_result: FAIL\n");
    return 1;
  }

  // The signed element count is positive after the ten-logit check above.
  const auto output_count = static_cast<size_t>(num_output_elements);
  printf("Output: %zu element(s):", output_count);
  const float* data = tensor.const_data_ptr<float>();
  for (size_t i = 0; i < output_count; ++i) {
    printf(" %.4f", static_cast<double>(data[i]));
  }
  printf("\nTest_result: PASS\n");
  fflush(stdout);
  return 0;
}
```

## src/zephyr_ac6_compat.hpp
```c
// Copyright 2026 Arm Limited and/or its affiliates.
// SPDX-License-Identifier: Apache-2.0
#pragma once

// AC6 libc++ uses these errno values in std::errc enumerators. Zephyr's
// armstdc errno.c supplies exactly these values, but the AC6 header exposes
// them as extern const int in AEABI portability mode, not constant expressions.
// Keep portability mode (and Zephyr's thread-local errno) for all other APIs.
#include <cerrno>
#undef EDOM
#undef ERANGE
#undef EILSEQ
#define EDOM 33
#define ERANGE 34
#define EILSEQ 138

// libc++ likewise needs constant LC_* masks. Use the native Arm locale
// constants from the installed header, without changing other C library ABIs.
#pragma push_macro("_AEABI_PORTABILITY_LEVEL")
#undef _AEABI_PORTABILITY_LEVEL
#define _AEABI_PORTABILITY_LEVEL 0
#include <clocale>
#pragma pop_macro("_AEABI_PORTABILITY_LEVEL")
```
